const unsigned char dmu[5000] = { /* 0X00,0X01,0XC8,0X00,0XC8,0X00, */
0XFF,0XFF,0XFF,0XFF,0XFF,0XFF,0XFF,0XFF,0XFF,0XFF,0XFF,0XFF,0XFF,0XFF,0XFF,0XFF,
0XFF,0XFF,0XFF,0XFF,0XFF,0XFF,0XFF,0XFF,0XFF,0XFF,0XFF,0XFF,0XFF,0XFF,0XFF,0XFF,
0XFF,0XFF,0XFF,0XFF,0XFF,0XFF,0XFF,0XFF,0XFF,0XFF,0XFF,0XFF,0XFF,0XFF,0XFF,0XFF,
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0XFF,0XFF,0XFF,0XFF,0XFF,0XFF,0XFF,0XFF,};
    /////////////////////////////////////////////////////////////////
   //              Arduino E-Paper Display Tutorial     v1.00     //
  //       Get the latest version of the code here:              //
 //      http://educ8s.tv/arduino-e-paper-display-review        //
/////////////////////////////////////////////////////////////////

#include <GxEPD.h>
#include <GxGDEH029A1/GxGDEH029A1.cpp>
#include <GxIO/GxIO_SPI/GxIO_SPI.cpp>
#include <GxIO/GxIO.cpp>
#include <Fonts/FreeMonoBold9pt7b.h>

#include <ESP8266WiFi.h>          //ESP8266 Core WiFi Library (you most likely already have this in your sketch)
#include <ESP8266HTTPClient.h>
#include <DNSServer.h>            //Local DNS Server used for redirecting all requests to the configuration portal
#include <ESP8266WebServer.h>     //Local WebServer used to serve the configuration portal
#include <WiFiManager.h>          //https://github.com/tzapu/WiFiManager WiFi Configuration Magic
#include <SPI.h>
#include <MFRC522.h>

//GxIO_Class io(SPI, SS, D3, D4);
GxIO_Class io(SPI, SS, D3, D1);
GxEPD_Class display(io);

#define RST_PIN D1 // RST-PIN for RC522 - RFID - SPI - Modul GPIO15 
#define SS_PIN  D8  // SDA-PIN for RC522 - RFID - SPI - Modul GPIO2
MFRC522 rfid(SS_PIN, RST_PIN);   // Create MFRC522 instance
byte nuidPICC[4];

void setup(void)
{
  Serial.begin(115200);
  display.init();
  display.setRotation(45);
  display.drawPaged(page);

  WiFiManager wifiManager;

  //first parameter is name of access point, second is the password
  wifiManager.autoConnect("myDevice", "myPass");
  getWeather();
  SPI.begin();           // Init SPI bus
  Serial.print("SPI Initialized");
  rfid.PCD_Init();    // Init MFRC522
  Serial.print("RFID Initialized");
}

void loop()
{
  Serial.println("hey");
  readRFID();
  delay(4000);
  //showInterwebs();
  //display.drawPaged(page1);
  /*display.drawPaged(page1);
  delay(4000);
  display.drawPaged(page2);
  delay(10000);
  display.drawPaged(page3);
  delay(10000);*/
}
void getWeather(){
  const char* name = "FreeMonoBold9pt7b";
  const GFXfont* f = &FreeMonoBold9pt7b;
  Serial.println("Retrieving Weather forecast");
  display.fillScreen(GxEPD_WHITE);
  display.setTextColor(GxEPD_BLACK);
  display.setFont(f);
  display.setCursor(0, 0);
  display.println("Retrieving weather forecast.");
  if (WiFi.status() == WL_CONNECTED) { //Check WiFi connection status
 
    HTTPClient http;  //Declare an object of class HTTPClient
 
    http.begin("http://tweety.gq/APIRequests.php?weather=true");  //Specify request destination
    int httpCode = http.GET();                                  //Send the request
 
    if (httpCode > 0) { //Check the returning code
 
      String payload = http.getString();   //Get the request response payload
      Serial.println(payload);                     //Print the response payload
      printWeatherForecast(payload);
    }
    http.end();   //Close connection
    return;
  }
  return;
}

void printWeatherForecast(String payload){
  const char* name = "FreeMonoBold9pt7b";
  const GFXfont* f = &FreeMonoBold9pt7b;
  //2018-02-08 00:00:00¬Rain¬light rain¬5.27
  display.fillScreen(GxEPD_WHITE);
  display.update();
  display.setTextColor(GxEPD_BLACK);
  display.setFont(f);
  display.setCursor(0, 0);
  display.print("\nWeather forecast:\n");
  for(int i = 0; i < payload.length(); i++){
    if(payload[i] == '#'){
      display.print("\n");
      Serial.println("This");
    }else{
      display.print(payload[i]);
      Serial.print(payload[i]);
    }
  }
  display.update();
}

void readRFID(){
    // Look for new cards
    if ( ! rfid.PICC_IsNewCardPresent()) 
    {
      return;
    }
    // Select one of the cards
    if ( ! rfid.PICC_ReadCardSerial()) 
    {
      return;
    }
    //Show UID on serial monitor
    Serial.print("UID tag :");
    String content= "";
    byte letter;
    for (byte i = 0; i < rfid.uid.size; i++) 
    {
       Serial.print(rfid.uid.uidByte[i] < 0x10 ? " 0" : " ");
       Serial.print(rfid.uid.uidByte[i], HEX);
       content.concat(String(rfid.uid.uidByte[i] < 0x10 ? " 0" : " "));
       content.concat(String(rfid.uid.uidByte[i], HEX));
    }
    Serial.println();
    Serial.print("Message : ");
    content.toUpperCase();
    content = content.substring(1);
    //Serial.println("AM I a happy person?START" + content.substring(1) + "END");
    confirmAttendance(content);
}
void confirmAttendance(String NUID){
   if(WiFi.status()== WL_CONNECTED){   //Check WiFi connection status
     HTTPClient http;    //Declare object of class HTTPClient
   
     http.begin("http://tweety.gq/APIRequests.php");      //Specify request destination
     http.addHeader("Content-Type", "text/plain");  //Specify content-type header

     String textSend = "Crd:" + NUID + "Node_1";
     //String textSend = "Crd:" + NUID + "Node_2";
     int httpCode = http.POST(textSend);   //Send the request
     //String payload = http.getString();                  //Get the response payload
     String toPrint = "\nCard read: " + http.getString();
     Serial.println(httpCode);   //Print HTTP return code
     Serial.println(toPrint);    //Print request response payload
     http.end();  //Close connection
     
     const char* name = "FreeMonoBold9pt7b";
     const GFXfont* f = &FreeMonoBold9pt7b;
     display.fillScreen(GxEPD_WHITE);
     display.setTextColor(GxEPD_BLACK);
     display.setFont(f);
     display.setCursor(0, 0);
     display.println(toPrint);
     display.update();
     delay(3000);
     tutorialMode(0);
     loop();
   }else{
      Serial.println("Error in WiFi connection");   
   }
}

void tutorialMode(int delayTime){
  delay(delayTime);
  const char* name = "FreeMonoBold9pt7b";
  const GFXfont* f = &FreeMonoBold9pt7b;
  display.fillScreen(GxEPD_WHITE);
  display.setTextColor(GxEPD_BLACK);
  display.setFont(f);
  display.setCursor(0, 0);
  display.println("\nCheck yourself!\nTap your student card on me");
  display.update();
}

void page()
{
  const char* name = "FreeMonoBold9pt7b";
  const GFXfont* f = &FreeMonoBold9pt7b;
  display.fillScreen(GxEPD_WHITE);
  display.setTextColor(GxEPD_BLACK);
  display.setFont(f);
  display.setCursor(0, 0);
  display.println("\nHello, device booted up.");
}

void page1()
{
  const char* name = "FreeMonoBold9pt7b";
  const GFXfont* f = &FreeMonoBold9pt7b;
  display.fillScreen(GxEPD_WHITE);
  display.setTextColor(GxEPD_BLACK);
  display.setFont(f);
  display.setCursor(65, 65);
  display.println("Prayer\n\n   C.P Cavafy\n\n   Translation \n Edmund Keeley\n Philip Sherrard");
}

void page2()
{
  const char* name = "FreeMonoBold9pt7b";
  const GFXfont* f = &FreeMonoBold9pt7b;
  display.fillScreen(GxEPD_WHITE);
  display.setTextColor(GxEPD_BLACK);
  display.setFont(f);
  display.setCursor(0, 0);
  display.println();
  display.println("The sea engulfed a sailor in its \ndepths.");
  display.println("Unaware, his \nmother goes and \nlights a tall");
  display.println("candle before the ikon of our Lady");
  display.println("praying for him to come back quickly,\nfor the weather to");
}

void page3()
{
  const char* name = "FreeMonoBold9pt7b";
  const GFXfont* f = &FreeMonoBold9pt7b;
  display.fillScreen(GxEPD_WHITE);
  display.setTextColor(GxEPD_BLACK);
  display.setFont(f);
  display.setCursor(0, 0);
  display.println();
  display.println("be good- her ear");
  display.println("cocked always to \nthe wind.");
  display.println("While she prays \nand supplicates,");
  display.println("the ikon listens, solemn, sad,");
  display.println("knowing the son \nshe waits for \nnever will come \nback. ");
}

void showInterwebs()
{

  display.fillScreen(GxEPD_WHITE);
  display.update();
  display.drawBitmap(dmu, 0, 0, 200, 200, GxEPD_BLACK);

  display.update();
}


