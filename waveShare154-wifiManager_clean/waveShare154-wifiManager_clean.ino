/************************************************************************************
   GxEPD_SPI_TestExample : test example for e-Paper displays from Dalian Good Display Co., Ltd.: www.good-display.com

   based on Demo Example from Good Display, now available on http://www.good-display.com/download_list/downloadcategoryid=34&isMode=false.html

   Author : J-M Zingg

   modified by :

   Version : 2.0

   Support: limited, provided as example, no claim to be fit for serious use

   connection to the e-Paper display is through DESTM32-S2 connection board, available from Good Display

   DESTM32-S2 pinout (top, component side view):
       |-------------------------------------------------
       |  VCC  |o o| VCC 5V, not needed
       |  GND  |o o| GND
       |  3.3  |o o| 3.3V
       |  nc   |o o| nc
       |  nc   |o o| nc
       |  nc   |o o| nc
       |  MOSI |o o| CLK=SCK
       | SS=DC |o o| D/C=RS    // Slave Select = Device Connect |o o| Data/Command = Register Select
       |  RST  |o o| BUSY
       |  nc   |o o| BS, connect to GND
       |-------------------------------------------------
*/

const int SLEEP_LENGTH = 200;
//50x50 pixels
#define yt3_width 100
#define yt3_height 61

static unsigned char youtube[112] = { /* 0X00,0X01,0X20,0X00,0X1C,0X00, */
0XDF,0XFF,0XFF,0XF7,0XBF,0XFF,0XFF,0XFB,0X7F,0XFF,0XFF,0XFD,0X60,0X00,0X00,0X06,
0X60,0X00,0X00,0X06,0X40,0X00,0X00,0X02,0XC0,0X00,0X00,0X03,0XC0,0X00,0X30,0X03,
0XC0,0X00,0X70,0X03,0XC0,0X00,0XF0,0X03,0XC0,0X01,0XF0,0X03,0XC0,0X03,0XF0,0X03,
0XC0,0X07,0XF0,0X03,0XC0,0X0F,0XF0,0X03,0XC0,0X0F,0XF0,0X03,0XC0,0X07,0XF0,0X03,
0XC0,0X03,0XF0,0X03,0XC0,0X01,0XF0,0X03,0XC0,0X00,0XF0,0X03,0XC0,0X00,0X70,0X03,
0XC0,0X00,0X30,0X03,0XC0,0X00,0X00,0X03,0X40,0X00,0X00,0X02,0X60,0X00,0X00,0X06,
0X60,0X00,0X00,0X06,0XBF,0XFF,0XFF,0XFD,0XDF,0XFF,0XFF,0XFB,0XEF,0XFF,0XFF,0XF7,
};



const unsigned char twitter[112] = { /* 0X00,0X01,0X20,0X00,0X1C,0X00, */
0XFF,0X9F,0XFF,0XFF,0X7C,0X07,0XFF,0XFF,0X80,0X03,0XFF,0XFB,0X80,0X01,0XFF,0XF9,
0X00,0X00,0XFF,0XF1,0XC0,0X00,0X7F,0XC1,0XC0,0X00,0X7F,0X81,0XC0,0X00,0X7E,0X01,
0XE0,0X00,0X70,0X01,0XE0,0X00,0X00,0X03,0XE0,0X00,0X00,0X01,0XE0,0X00,0X00,0X01,
0XF0,0X00,0X00,0X01,0XF0,0X00,0X00,0X01,0XF0,0X00,0X00,0X03,0XF8,0X00,0X00,0X07,
0XF8,0X00,0X00,0X0F,0XF8,0X00,0X00,0X07,0XFC,0X00,0X00,0X0F,0XFE,0X00,0X00,0X0F,
0XFE,0X00,0X00,0X3F,0XFF,0X00,0X00,0XFF,0XFF,0X80,0X00,0XFF,0XFF,0XC0,0X00,0X1F,
0XFF,0XF0,0X00,0X00,0XFF,0XF8,0X00,0X01,0XFF,0XFF,0X00,0X0F,0XFF,0XFF,0XF0,0XFF,
};
const unsigned char interwebs[5000] = { /* 0X00,0X01,0XC8,0X00,0XC8,0X00, */
0XFF,0XFF,0XFF,0XFF,0XFF,0XFF,0XFF,0XFF,0XFF,0XFF,0XFF,0XFF,0XFF,0XFF,0XFF,0XFF,
0XFF,0XFF,0XFF,0XFF,0XFF,0XFF,0XFF,0XFF,0XFF,0XFF,0XFF,0XFF,0XFF,0XFF,0XFF,0XFF,
0XFF,0XFF,0XFF,0XFF,0XFF,0XFF,0XFF,0XFF,0XFF,0XFF,0XFF,0XFF,0XFF,0XFF,0XFF,0XFF,
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0XFF,0XFF,0XFF,0XFF,0XFF,0XFF,0XFF,0XFF,};

const unsigned char interwebs2[5006] = { /* 0X00,0X01,0XC8,0X00,0XC8,0X00, */
0XFF,0XFF,0XFF,0XFF,0XFF,0XFF,0XFF,0XFF,0XFF,0XFF,0XFF,0XFF,0XFF,0XFF,0XFF,0XFF,
0XFF,0XFF,0XFF,0XFF,0XFF,0XFF,0XFF,0XFF,0XFF,0XFF,0XFF,0XFF,0XFF,0XFF,0XFF,0XFF,
0XFF,0XFF,0XFF,0XFF,0XFF,0XFF,0XFF,0XFF,0XFF,0XFF,0XFF,0XFF,0XFF,0XFF,0XFF,0XFF,
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0XFF,0XFC,0XC9,0X4A,0X48,0X7F,0XFF,0XFF,};


const unsigned char dmu[5000] = { /* 0X00,0X01,0XC8,0X00,0XC8,0X00, */
0XFF,0XFF,0XFF,0XFF,0XFF,0XFF,0XFF,0XFF,0XFF,0XFF,0XFF,0XFF,0XFF,0XFF,0XFF,0XFF,
0XFF,0XFF,0XFF,0XFF,0XFF,0XFF,0XFF,0XFF,0XFF,0XFF,0XFF,0XFF,0XFF,0XFF,0XFF,0XFF,
0XFF,0XFF,0XFF,0XFF,0XFF,0XFF,0XFF,0XFF,0XFF,0XFF,0XFF,0XFF,0XFF,0XFF,0XFF,0XFF,
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0XFF,0XFF,0XFF,0XFF,0XFF,0XFF,0XFF,0XFF,};

const unsigned char david[5000] = { /* 0X00,0X01,0XC8,0X00,0XC8,0X00, */
0XFF,0XFF,0XFF,0XFF,0XFF,0XFF,0XFD,0XB5,0XD5,0X55,0X55,0X57,0X55,0X50,0X03,0X55,
0X56,0XDB,0XB6,0XEF,0X7B,0X6D,0XED,0X55,0X55,0XFF,0XFF,0XFF,0XFF,0XFF,0XFF,0XFF,
0X6A,0XAA,0XAA,0XAE,0XAC,0X80,0X00,0X01,0X6A,0XAD,0XB5,0X6D,0X5A,0XD6,0XDB,0X5A,
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0X55,0XAF,0XBB,0XFF,0XFF,0XFF,0XFF,0XFF,};

// include library, include base class, make path known

#include <FS.h>
#include <GxEPD.h>
#include <time.h>
#define min(a, b) ((a) < (b) ? (a) : (b))

//#include "IMG_0001.h"

// select the display class to use, only one
#include <GxGDEP015OC1/GxGDEP015OC1.cpp>

// uncomment next line for drawBitmap() test, (consumes RAM on ESP8266)
//#include GxEPD_BitmapExamples

// FreeFonts from Adafruit_GFX
#include <Fonts/FreeSans9pt7b.h>
#include <Fonts/FreeMonoBold12pt7b.h>
#include <Fonts/FreeMonoBold18pt7b.h>
#include <Fonts/FreeMonoBold24pt7b.h>

#include <GxIO/GxIO_SPI/GxIO_SPI.cpp>
#include <GxIO/GxIO.cpp>

#if defined(ESP8266)

// generic/common.h
//static const uint8_t SS    = 15;
//static const uint8_t MOSI  = 13;
//static const uint8_t MISO  = 12;
//static const uint8_t SCK   = 14;
// pins_arduino.h
//static const uint8_t D8   = 15;
//static const uint8_t D7   = 13;
//static const uint8_t D6   = 12;
//static const uint8_t D5   = 14;

// GxIO_SPI(SPIClass& spi, int8_t cs, int8_t dc, int8_t rst = -1, int8_t bl = -1);
GxIO_Class io(SPI, SS, D3, D4); // arbitrary selection of D3, D4 selected for default of GxEPD_Class
// GxGDEP015OC1(GxIO& io, uint8_t rst = D4, uint8_t busy = D2);
GxEPD_Class display(io); // default selection of D4, D2
// my IoT connection, busy on MISO
//GxEPD_Class display(io, D4, D0);
#endif
#include <ESP8266WiFi.h>

const char *host = "**host**";
const char *channelNameTW = "**channel**";
const char *channelName = "**channel**";
const char *apiKey = "***api key***";
String countReturn;
boolean started = false;
boolean started2 = false;
boolean started3 = false;
int subsCount = 0;
String timeReturn;
int tempSubs = 0;
String tempFollowers = "";
int followers = 0;
#include <ESP8266WiFi.h> //https://github.com/esp8266/Arduino

//needed for library
#include <DNSServer.h>
#include <ESP8266WebServer.h>
#include <WiFiManager.h> //https://github.com/tzapu/WiFiManager

void setup()
{
  // put your setup code here, to run once:
  Serial.begin(115200);
  display.init();
  display.setRotation(0);
  //WiFiManager
  //Local intialization. Once its business is done, there is no need to keep it around
  WiFiManager wifiManager;
  //reset saved settings
  wifiManager.resetSettings();

  //set custom ip for portal
  wifiManager.setAPConfig(IPAddress(10, 0, 1, 1), IPAddress(10, 0, 1, 1), IPAddress(255, 255, 255, 0));

  //fetches ssid and pass from eeprom and tries to connect
  //if it does not connect it starts an access point with the specified name
  //here  "AutoConnectAP"
  //and goes into a blocking loop awaiting configuration
  wifiManager.autoConnect("TEO-812776", "slaptazodis");
  //or use this for auto generated name ESP + ChipID
  //wifiManager.autoConnect();

  //if you get here you have connected to the WiFi
  Serial.println("connected...yeey :)");
}

void loop()
{
  //delay(1000);
  showDMU();
  countReturn = "";
  timeReturn = "";
  tempSubs = 0;
  tempFollowers = "";
  WiFiClient client;

  const int httpPort = 80;
  if (!client.connect(host, httpPort))
  {
    //Serial.println("connection failed");
    return;
  }
  String url = "***website***  subcount/youtube-subcount.php";
  url += "?apiKey=";
  url += apiKey;
  url += "&channelName=";
  url += channelName;

  //Serial.print("Requesting URL: ");
  //Serial.println(url);

  client.print(String("GET ") + url + " HTTP/1.1\r\n" +
               "Host: " + host + "\r\n" +
               "Connection: close\r\n\r\n");
  unsigned long timeout = millis();
  while (client.available() == 0)
  {
    if (millis() - timeout > 10000)
    {
      //Serial.println(">>> Client Timeout !");
      client.stop();
      return;
    }
  }

  // Read all the lines of the reply from server and print them to Serial
  while (client.available())
  {
    char c = client.read();
    if (c == '*')
    {
      if (started == false)
      {
        started = true;
      }
      else
      {
        started = false;
      }
    }
    else
    {
      if (started == true)
      {
        countReturn += c;
      }
    }
  }

  if (!client.connect(host, httpPort))
  {
    //Serial.println("connection failed");
    return;
  }
  String url2 = "***website*** /subcount/time.php";

  //Serial.print("Requesting URL: ");
  //Serial.println(url);

  client.print(String("GET ") + url2 + " HTTP/1.1\r\n" +
               "Host: " + host + "\r\n" +
               "Connection: close\r\n\r\n");
  unsigned long timeout2 = millis();
  while (client.available() == 0)
  {
    if (millis() - timeout2 > 10000)
    {
      //Serial.println(">>> Client Timeout !");
      client.stop();
      return;
    }
  }

  // Read all the lines of the reply from server and print them to Serial
  while (client.available())
  {
    char c2 = client.read();
    if (c2 == '*')
    {
      if (started2 == false)
      {
        started2 = true;
      }
      else
      {
        started2 = false;
      }
    }
    else
    {
      if (started2 == true)
      {
        timeReturn += c2;
      }
    }
  }

  if (!client.connect(host, httpPort))
  {
    //Serial.println("connection failed");
    return;
  }
  String url3 = "***website*** twitter-api-php-master/twitter.php?channelName=";
  url3 += channelNameTW;

  //Serial.print("Requesting URL: ");
  //Serial.println(url);

  client.print(String("GET ") + url3 + " HTTP/1.1\r\n" +
               "Host: " + host + "\r\n" +
               "Connection: close\r\n\r\n");
  unsigned long timeout3 = millis();
  while (client.available() == 0)
  {
    if (millis() - timeout3 > 10000)
    {
      //Serial.println(">>> Client Timeout !");
      client.stop();
      return;
    }
  }

  // Read all the lines of the reply from server and print them to Serial
  while (client.available())
  {
    char c3 = client.read();
    if (c3 == '*')
    {
      if (started3 == false)
      {
        started3 = true;
      }
      else
      {
        started3 = false;
      }
    }
    else
    {
      if (started3 == true)
      {
        tempFollowers += c3;
      }
    }
  }
  int tempFollowers2 = tempFollowers.toInt();
  tempSubs = countReturn.toInt();
  if (tempFollowers2 < 1)
  {
  }
  else
  {
    if (tempFollowers2 != followers)
    {
      followers = tempFollowers2;
    }
  }

  if (tempSubs < 1)
  {
  }
  else
  {
    if (subsCount != tempSubs)
    {
      subsCount = tempSubs;
    }
  }
  //showFace();
  // delay(1000);
  showInterwebs();
  delay(2000);
  showSubs();

  ESP.deepSleep(SLEEP_LENGTH * 60 * 1000 * 100);
  //delay(60000);
}

void showSubs()
{
  display.fillScreen(GxEPD_WHITE);
  //display.update();
  display.setTextColor(GxEPD_BLACK);
  display.setFont(&FreeSans9pt7b);
  display.drawBitmap(youtube, 5, 0, 32, 28, GxEPD_BLACK);
  display.setCursor(41, 18);
  //display.drawBitmap(youtube, 0, 0, 50, 50, GxEPD_BLACK);
  //display.drawBitmap(youtube, 0, 0, 50, 50, GxEPD_BLACK); // new signature
  display.println("Youtube");
  display.setCursor(41, 100);
  display.drawBitmap(twitter, 5, 85, 32, 28, GxEPD_BLACK);
  display.println("Twitter");
  display.setFont(&FreeMonoBold24pt7b);
  display.setCursor(5, 65);
  //display.println();
  display.println(subsCount);
  display.setCursor(5, 150);
  display.println(tempFollowers);
  display.fillRect(0, 75, 200, 3, GxEPD_BLACK);
  display.fillRect(0, 160, 200, 3, GxEPD_BLACK);
  display.setFont(&FreeSans9pt7b);
  display.setCursor(5, 185);
  display.println(timeReturn);
  display.update();
}
void showFace()
{
  display.fillScreen(GxEPD_WHITE);
  display.update();
  display.drawBitmap(david, 0, 0, 200, 200, GxEPD_BLACK);

  display.update();
}
void showInterwebs()
{

  display.fillScreen(GxEPD_WHITE);
  display.update();
  display.drawBitmap(dmu, 0, 0, 200, 200, GxEPD_BLACK);

  display.update();
}